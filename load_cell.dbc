VERSION ""

NS_ :

BS_:

BU_: VCU Load_Cell

BO_ 1592 Load_Cell_Data: 2 Load_Cell
 SG_ Output_Voltage : 7|16@0- (10,0) [-32768|32767] ""  VCU

BA_DEF_  "BusType" STRING ;
BA_DEF_DEF_  "BusType" "CAN";
