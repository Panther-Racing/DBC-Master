VERSION ""

NS_ :

BS_:

BU_:

BO_ 1009 SGAMP2_data1000Hz: 3 Vector__XXX

 SG_ SGAMP2_ambientTemp m0 : 23|8@0- (0,0) [0.0|255.0] "C" Vector__XXX

 SG_ SGAMP2_outputVoltage  m0 : 7|16@0- (7.629395e-05,2.5) [-32768.0|32767.0] "V" Vector__XXX

BA_DEF_ BO_  "GenMsgCycleTime" INT 0 65535;

BA_DEF_DEF_  "GenMsgCycleTime" 0;

BA_ "GenMsgCycleTime" BO_ 1009 100;
