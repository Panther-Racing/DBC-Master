VERSION ""

NS_ :

BS_:

BU_: VCU

BO_ 1008 SGAMP1_data1000Hz: 3 Vector__XXX
 SG_ SGAMP1_ambientTemp : 23|8@0- (1,0) [0|0] "C"  VCU
 SG_ SGAMP1_outputVoltage : 7|16@0- (7.62939453125E-005,2.5) [-32768|32767] "V"  VCU

BO_ 1009 SGAMP2_data1000Hz: 3 Vector__XXX
 SG_ SGAMP2_ambinetTemp : 23|8@0- (1,0) [0|0] "" Vector__XXX
 SG_ SGAMP2_outputVoltage : 7|16@0- (7.62939453125E-005,2.5) [-32768|32767] "V" Vector__XXX

BO_ 1010 SGAMP3_data1000Hz: 3 Vector__XXX
 SG_ SGAMP3_ambientTemp : 23|8@0- (1,0) [0|0] "" Vector__XXX
 SG_ SGAMP3_outputVoltage : 7|16@0- (7.62939453125E-005,2.5) [-32768|32767] "V" Vector__XXX

BO_ 1011 SGAMP4_data1000Hz: 3 Vector__XXX
 SG_ SGAMP4_ambientTemp : 23|8@0- (1,0) [0|0] "" Vector__XXX
 SG_ SGAMP4_outputVoltage : 7|16@0- (7.62939453125E-005,2.5) [-32768|32767] "V" Vector__XXX

BA_DEF_ BO_  "GenMsgCycleTime" INT 0 65535;
BA_DEF_DEF_  "GenMsgCycleTime" 0;
BA_ "GenMsgCycleTime" BO_ 1008 10;
BA_ "GenMsgCycleTime" BO_ 1009 100;
BA_ "GenMsgCycleTime" BO_ 1010 100;
BA_ "GenMsgCycleTime" BO_ 1011 100;
