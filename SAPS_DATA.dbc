VERSION ""

NS_ :

BS_:

BU_: VCU

BO_ 1798 SAPS_RW1_pressureInfo100Hz: 8 Vector__XXX
 SG_ SAPS_RW_Mux M : 7|8@0- (1,0) [0|255] ""  VCU
 SG_ SAPS_RW_pressure8 m8 : 15|23@0+ (0.15625,0) [0|4914303] "Pa"  VCU
 SG_ SAPS_RW_pressure7 m7 : 15|23@0+ (0.15625,0) [0|4914303] "Pa"  VCU
 SG_ SAPS_RW_pressure6 m6 : 15|23@0+ (0.15625,0) [0|4914303] "Pa"  VCU
 SG_ SAPS_RW_pressure5 m5 : 15|23@0+ (0.15625,0) [0|4914303] "Pa"  VCU
 SG_ SAPS_RW_pressure4 m4 : 15|23@0+ (0.15625,0) [0|4914303] "Pa"  VCU
 SG_ SAPS_RW_pressure3 m3 : 15|23@0+ (0.15625,0) [0|4914303] "Pa"  VCU
 SG_ SAPS_RW_pressure2 m2 : 15|23@0+ (0.15625,0) [0|4914303] "Pa"  VCU
 SG_ SAPS_RW_pressure1 m1 : 15|23@0+ (0.15625,0) [0|4914303] "Pa"  VCU

BA_DEF_  "BusType" STRING ;
BA_DEF_DEF_  "BusType" "CAN";
