VERSION ""

NS_ :

BS_:

BU_: VCU

BO_ 0 SAPS_Board1: 8 Vector__XXX
 SG_ SAPS_Board1Mux M : 7|8@0- (1,0) [0|255] ""  VCU
 SG_ pressure8 m7 : 15|22@0- (1E-010,0) [0|4914303] "kPa"  VCU
 SG_ pressure7 m6 : 15|22@0- (1E-010,0) [0|4914303] "kPa"  VCU
 SG_ pressure6 m5 : 15|22@0- (1E-010,0) [0|4914303] "kPa"  VCU
 SG_ pressure5 m4 : 15|22@0- (1E-010,0) [0|4914303] "kPa"  VCU
 SG_ pressure4 m3 : 15|22@0- (1E-010,0) [0|4914303] "kPa"  VCU
 SG_ pressure3 m2 : 15|22@0- (1E-010,0) [0|4914303] "kPa"  VCU
 SG_ pressure2 m1 : 15|22@0- (1E-010,0) [0|4914303] "kPa"  VCU
 SG_ pressure1 m0 : 15|22@0- (1E-010,0) [0|4914303] "kPa"  VCU

BA_DEF_  "BusType" STRING ;
BA_DEF_DEF_  "BusType" "CAN";
