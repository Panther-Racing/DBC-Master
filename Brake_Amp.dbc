VERSION ""

NS_ :

BS_:

BU_: VCU

BO_ 1012 Brake_Amp: 3 Vector__XXX
 SG_ Brake_Amp_outputVoltage : 7|16@0- (7.629394531E-05,2.5) [-32768|32767] "V"  VCU
 SG_ Brake_Amp_ambientTemp : 23|8@0- (1,0) [0|0] "C"  VCU

BA_DEF_  "BusType" STRING ;
BA_DEF_DEF_  "BusType" "CAN";
