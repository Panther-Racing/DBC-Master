VERSION ""

NS_ :

BS_:

BU_: BMS MC PDM D153 VCU

BO_ 1600 VCU_coolantInfo10Hz: 8 VCU
 SG_ VCU_coolantInfo10HzMux M : 7|8@0+ (1,0) [0|255] "" Vector__XXX
 SG_ VCU_accuCoolantPressIn m0 : 15|16@0- (0.1,0) [0|300] "kPa" Vector__XXX

BA_DEF_  "BusType" STRING ;
BA_DEF_DEF_  "BusType" "CAN";
